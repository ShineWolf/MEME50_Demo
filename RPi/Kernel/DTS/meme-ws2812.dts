/dts-v1/;
/plugin/;

/ {
    compatible = "brcm,bcm2837";
 
    fragment@0 {
        target = <&spi0>;
        __overlay__ {
            #address-cells = <1>;
            #size-cells = <0>;

            ws2812@0 {
                compatible = "meme,ws2812";
                reg = <0>; 
                spi-max-frequency = <24000000>; //若 SPI 頻率設為 2.4MHz，則每 bit 時間為 ~416ns，剛好可以用 3 個 SPI bit 模擬一個 WS2812 bit：
            };
        };
    };

    fragment@99 {
        target = <&spi0>;
        __overlay__ {
	        #address-cells = <1>;
        	#size-cells = <0>;
            spidev@0 {
		        reg = <0>;
                status = "disabled";
            };
        };
    };
};

